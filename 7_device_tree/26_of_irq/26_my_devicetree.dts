#include "rk3568-evb1-ddr4-v1-.dtsi"

/{
    topeet{
        #address-cells = <1>;
        #size-cells= <1>;
        compatible = "simple-bus";
        myled{
            compatible = "my_devicetree";
            reg = <0x00002344, 0x00000001>;
        };
        myirq{
            compatible = "my_devicetree";
            interrupt-parent = <$gpio1>;
            interrupts = <RK_PB5 IRQ_TYPE_LEVEL_HIGH>;
        };
    };
};