/dts-v1/;

/ {

	fragment@0 {
		target-path = "/rk-485-ctl";

		__overlay__ {

			overlay_node {
				status = "okay";
			};
		};
	};

	fragment@1 {
		target = <0xffffffff>;

		__overlay__ {

			overlay_node {
				status = "okay";
			};
		};
	};

	__fixups__ {
		rk_485_ctl = "/fragment@1:target:0";
	};
};
